## conf/layer.conf
```bitbake
# We have a conf and classes directory, add to BBPATH
BBPATH .= ":${LAYERDIR}"

# We have recipes-* directories, add to BBFILES
BBFILES += "${LAYERDIR}/recipes-*/*/*.bb \
	${LAYERDIR}/recipes-*/*/*.bbappend"

BBFILE_COLLECTIONS += "rabbitpi"
BBFILE_PATTERN_rabbitpi = "^${LAYERDIR}/"
BBFILE_PRIORITY_rabbitpi = "10"
```
